# 1 "arch/arm/boot/dts/sprd-scx35_coreprimeve3g.dts"
# 1 "<command-line>"
# 1 "arch/arm/boot/dts/sprd-scx35_coreprimeve3g.dts"
# 9 "arch/arm/boot/dts/sprd-scx35_coreprimeve3g.dts"
/dts-v1/;


/memreserve/ 0x87800000 0x240000;


/memreserve/ 0x88000000 0x1c00000;


/memreserve/ 0x9F197000 0x465000;


/memreserve/ 0x9F5FC000 0x404000;

/include/ "sprd-scx35_2.dtsi"
/include/ "sprd-scx35_sc7730.dtsi"

# 1 "/home/chetna.ahuja/OSLV/G361H/Kernel/arch/arm/boot/dts/include/dt-bindings/gpio/gpio.h" 1
# 27 "arch/arm/boot/dts/sprd-scx35_coreprimeve3g.dts" 2
# 1 "/home/chetna.ahuja/OSLV/G361H/Kernel/arch/arm/boot/dts/include/dt-bindings/interrupt-controller/irq.h" 1
# 28 "arch/arm/boot/dts/sprd-scx35_coreprimeve3g.dts" 2
/ {
 model = "Spreadtrum SP7730G board";
        sprd,sc-id = <8830 0 0x20000>;
 chosen {
  bootargs = "loglevel=7 init=/init root=/dev/ram0 rw";
  linux,initrd-start = <0x85500000>;
  linux,initrd-end = <0x855a3212>;
 };

 aliases {
  i2c_gpio6 = &i2c_gpio6;
  i2c_gpio7 = &i2c_gpio7;

 };

 memory {
  device_type = "memory";
  reg = <0x80000000 0x40000000>;
 };

 gpio_keys {
  compatible = "gpio-keys";
  home {
   label = "Home Key";
   linux,code = <102>;
   gpio = <&d_gpio_gpio 113 1>;
   debounce-interval = <2>;
   gpio-key,wakeup;
  };
 };

 sprd_simdet {
  compatible = "sprd,sim_detect";
  sprd,name = "simdet";
  gpios = <&d_gpio_gpio 162 0>;
  irq_trigger_level_detect = <1>;
  delay_time = <100>;
 };

 bcm4343{
  compatible = "broadcom,bcm4343";
  gpios = <&d_gpio_gpio 231 0
                 &d_gpio_gpio 45 0
                 &d_gpio_gpio 46 0>;
 };

i2c_gpio6: i2c_gpio@0 {
  compatible = "i2c-gpio";
  #address-cells = <1>;
  #size-cells = <0>;
  gpios = <&d_gpio_gpio 159 0
                        &d_gpio_gpio 160 0 >;
  i2c-gpio,delay-us = <10>;
  i2c-gpio,timeout-ms = <0>;

  sm5701-i2c@49 {
   compatible = "sm,sm5701";
   reg = <0x49>;
   chargermfd {
    charger {
     compatible = "sm,sm5701-charger";
     chgen-gpio = <&d_gpio_gpio 215 0>;
     chgirq-gpio = <&d_gpio_gpio 161 0>;
     chg-float-voltage = <4400>;
    };
   };
                        leds_sm5701 {
                                        compatible = "sm,leds_sm5701";
                                        flashen-gpio = <&d_gpio_gpio 81 0>;
                                        flashtorch-gpio = <&d_gpio_gpio 83 0>;
                        };

  };
 };

i2c_gpio7: i2c_gpio@2 {
      compatible = "i2c-gpio";
#address-cells = <1>;
#size-cells = <0>;
      gpios = <&d_gpio_gpio 150 0
       &d_gpio_gpio 151 0 >;
      i2c-gpio,delay-us = <10>;
      i2c-gpio,timeout-ms = <0>;

      sm5504@14 {
       compatible = "SiliconMitus,sm5504";
       reg = <0x14>;
       interrupt-parent = <&d_gpio_gpio>;
       sm5504,irq-gpio = <&d_gpio_gpio 149 0>;
      };
     };

     gps {
      compatible = "broadcom,bcm47520";
      gps-pwr-en = <&d_gpio_gpio 168 0>;
      gps-regulator = "vddsim2";
     };

     sec_thermistor {
      compatible = "sec,thermistor";
     };

 sec-fuelgauge {
  compatible = "samsung,sec-fuelgauge";
  capacity-max = <1000>;
  capacity-max-margin = <1000>;
  capacity-min = <10>;
  fg-irq-attr = <0>;
  fuel-alert-soc = <1000>;
  temp_adc_channel = <0>;
  chg_bat_safety_vol = <4600>;
  gpios = <&a_eic_gpio 0 0>;
  soft_vbat_uvlo = <3050>;
  vmode = <0>;
  alm_soc = <5>;
  alm_vbat = <3500>;
  rint = <200>;
  cnom = <2000>;
  rsense_real = <210>;
  rsense_spec = <200>;
  relax_current = <50>;
  cal_ajust = <0>;
  ocv_table = <4370 100
     4332 95
     4277 90
     4221 85
     4166 80
     4113 75
     4063 70
     4018 65
     3977 60
     3933 55
     3881 50
     3850 45
     3826 40
     3807 35
     3791 30
     3778 25
     3762 20
     3742 15
     3711 10
     3683 5
     3400 0>;
  sprd_fgu: sprd_fgu{
   compatible = "sprd,sprd_fgu";
   interrupt-parent = <&adi>;
   interrupts = <4 0x0>;
  };
 };

     sec-battery {
      compatible = "samsung,sec-battery";
      battery,vendor = "SDI SDI";
      battery,charger_name = "sec-charger";
      battery,fuelgauge_name = "sec-fuelgauge";
      battery,technology = <2>;

      battery,chip_vendor = "SPRD";
      battery,temp_adc_type = <1>;

      battery,polling_time = <10 30 30 30 3600>;

      battery,adc_check_count = <5>;

      battery,cable_check_type = <4>;
      battery,cable_source_type = <3>;
      battery,event_waiting_time = <600>;
      battery,polling_type = <1>;
      battery,monitor_initial_count = <3>;

         battery,battery_check_type = <5>;
      battery,check_count = <0>;
      battery,check_adc_max = <1440>;
      battery,check_adc_min = <0>;

      battery,ovp_uvlo_check_type = <4>;

      battery,thermal_source = <2>;

      battery,temp_table_adc = <456 534 626 732 849 991 1134 1274 1314 1508 1705 1908 2149 2394 2639 2876 3068 3261 3443 3511 3603 3736 3846>;
              battery,temp_table_data = <800 750 700 650 600 550 500 460 450 400 350 300 250 200 150 100 50 0 (-50) (-70) (-100) (-150) (-200)>;

      battery,temp_check_type = <2>;
      battery,temp_check_count = <1>;
      battery,temp_high_threshold_event = <600>;
      battery,temp_high_recovery_event = <470>;
      battery,temp_low_threshold_event = <(-50)>;
      battery,temp_low_recovery_event = <10>;
      battery,temp_high_threshold_normal = <600>;
      battery,temp_high_recovery_normal = <470>;
      battery,temp_low_threshold_normal = <(-50)>;
      battery,temp_low_recovery_normal = <10>;
      battery,temp_high_threshold_lpm = <600>;
      battery,temp_high_recovery_lpm = <470>;
      battery,temp_low_threshold_lpm = <(-50)>;
            battery,temp_low_recovery_lpm = <10>;
      battery,full_check_type = <7>;
      battery,full_check_type_2nd = <3>;
      battery,full_check_count = <1>;
      battery,chg_gpio_full_check = <0>;
      battery,chg_polarity_full_check = <1>;

      battery,full_condition_type = <15>;
      battery,full_condition_soc = <100>;
      battery,full_condition_vcell = <4200>;

      battery,recharge_check_count = <1>;
      battery,recharge_condition_type = <4>;
      battery,recharge_condition_soc = <98>;
      battery,recharge_condition_vcell = <4350>;

      battery,charging_total_time = <21600>;
      battery,recharging_total_time = <5400>;
      battery,charging_reset_time = <0>;

      battery,always_enable;

      battery,swelling_high_temp_block = <500>;
      battery,swelling_high_temp_recov = <450>;
      battery,swelling_low_temp_block = <50>;
      battery,swelling_low_temp_recov = <100>;
      battery,swelling_chg_current = <975>;
      battery,swelling_drop_float_voltage = <4200>;
      battery,swelling_high_rechg_voltage = <4150>;
      battery,swelling_low_rechg_voltage = <4050>;
      battery,swelling_block_time = <600>;

      charger,vbus_ctrl_gpio = <&d_gpio_gpio 64 0x00>;
      battery,chg_gpio_en = <0>;
      battery,chg_polarity_en = <0>;
      battery,chg_gpio_status = <0>;
      battery,chg_polarity_status = <0>;
      battery,chg_float_voltage = <4400>;
      battery,chg_min_system_voltage = <3100>;
      battery,input_current_limit = <700 460 460 700 460 700 700 460 460 700 700 700 700 460 700 300 700 700 300 700 700 460 460>;
      battery,fast_charging_current = <975 0 975 975 975 975 975 975 0 975 975 975 975 (-1) 975 975 975 975 975 975 975 0 0>;
      battery,full_check_current_1st = <175 0 175 175 175 175 175 175 0 175 175 175 175 0 175 175 175 175 175 175 175 0 0>;
      battery,full_check_current_2nd = <1800 0 1800 1800 1800 1800 1800 1800 0 1800 1800 1800 1800 0 1800 1800 1800 1800 1800 1800 1800 0 0>;
     };
 backlight: ktd2801-bl {
  compatible = "kinetic,backlight-ktd2801";
  backlight-name = "panel";
  backlight-brt-range = <
   0 0
   5 7
   5 7
   143 95
   255 210
  >;
  gen-panel-outdoor-mode-en;
  backlight-brt-outdoor = <
   255 255
  >;
  bl-ctrl = <&d_gpio_gpio 234 0>;
 };

 panel {
  compatible = "sprd,sprdfb-dsi-panel";
  pinctrl-names = "default";
  gen-panel = <&gen_panel>;
  gen-panel-backlight = <&backlight>;
  interrupt-parent = <&d_gpio_gpio>;
  interrupts = <236 1>;
  gen-panel-esd-gpio = <&d_gpio_gpio 236 0>;
  gen-panel-esd-type = <1>;
  panel-ext-pin {
# 308 "arch/arm/boot/dts/sprd-scx35_coreprimeve3g.dts"
  };
  gen_panel: gen-panel {};
     };


 keypad@40250000 {
  compatible = "sprd,sci-keypad";
  reg = <0X40250000 0x1000>;
  gpios = <&a_eic_gpio 2 0>,<&a_eic_gpio 10 0>;
  interrupts = <0 36 0x0>;
  sprd,keypad-num-rows = <1>;
  sprd,keypad-num-columns = <3>;
  sprd,keypad-rows-choose-hw = <0x10000>;
  sprd,keypad-cols-choose-hw = <0x700>;
  sprd,debounce_time = <5000>;
  linux,keypad-no-autorepeat;
  #sprd,support_long_key;

  key_volume_up {
   keypad,row = <0>;
   keypad,column = <0>;
   linux,code = <115>;
  };

  key_volume_up1 {
   keypad,row = <0>;
   keypad,column = <2>;
   linux,code = <115>;
  };

  key_home {
   keypad,row = <0>;
   keypad,column = <1>;
   linux,code = <172>;
  };
 };
};

/include/ "sprd-dsi-panel-dsi_sc7798d_wVGA_video.dtsi"

&pinctrl {
 pwr_domain ="vdd18",
      "vdd18",
      "vddsim0",
      "vddsim1",
      "vdd18",
      "vddsdcore",
      "vdd18";
};

&i2c0 {
 sensor_main@0x3c {
  compatible = "sprd,sensor_main";
  reg = <0x3c>;
 };
 sensor_sub@0x21 {
  compatible = "sprd,sensor_sub";
  reg = <0x21>;
 };
};


&i2c1 {
  ist30xxc@50 {
  compatible = "imagis,ist30xxc";
  reg = <0x50>;
  imagis,power-src = "vddsdio";
  gpios = <&d_gpio_gpio 82 0>;
  interrupt-parent = <&d_gpio_gpio>;
  interrupts = <82 0x1>;
  imagis,irq-flag = <0x2002>;
  imagis,irq-gpio = <&d_gpio_gpio 82 0x00>;
  imagis,avdd-volt = <3000000>;
  imagis,max-x = <480>;
  imagis,max-y = <800>;
  imagis,max-w = <15>;
  imagis,chip-id = <0x032C>;

    imagis,chip-name = "IST3032C";
    imagis,chip-code = <2>;

    imagis,max-node = <256>;

 };
};

&i2c2 {
 status = "okay";
 gp2a-i2c@44{
   compatible = "gp2a-i2c";
   reg = <0x44>;
   interrupt-parent = <&d_gpio_gpio>;
   interrupts = <216 0>;
   gp2a-i2c,irq-gpio = <&d_gpio_gpio 216 0x00>;
   gp2a-i2c,en-gpio = <&d_gpio_gpio 163 0x01>;
   gp2a-vdd-supply = <&vddkpled>;
  };

 k2hh@1D {
  compatible = "stm,k2hh";
  reg = <0x1D>;
  interrupt-parent = <&d_gpio_gpio>;
  interrupts = <164 0>;
  stm,irq_gpio = <&d_gpio_gpio 164 0x00>;
  stm,axis_map_x = <1>;
  stm,axis_map_y = <0>;
  stm,axis_map_z = <2>;
  stm,negate_x = <1>;
  stm,negate_y = <1>;
  stm,negate_z = <0>;
  stm,poll_interval = <100>;
  stm,min_interval = <2>;
 };
};

&i2c3 {
 bridge@64 {
  compatible = "quicklogic,i2c";
  reg = <0x64>;
  gpio_bridge_en = <&d_gpio_gpio 233 0>;
  gpio_bridge_rst = <&d_gpio_gpio 234 0>;
  gpio_backlight_en = <&d_gpio_gpio 214 0>;
  gpio_lcd_3v3_en = <&d_gpio_gpio 152 0>;
 };
};

&fb0 {
 sprd,fb_use_reservemem;
 sprd,fb_mem = <0x9F197000 0x465000>;
};

&usb {
 tune_value = <0x4407ae33>;
};

&l_sprd_sensor {
 gpios = <&d_gpio_gpio 186 0
  &d_gpio_gpio 188 0
  &d_gpio_gpio 238 0
  &d_gpio_gpio 187 0
  &d_gpio_gpio 193 0
  &d_gpio_gpio 0 0
  &d_gpio_gpio 0 0
  &d_gpio_gpio 0 0>;
};

&l_ion {
 sprd,ion-heap@1 {
  sprd,ion-heap-mem = <0x0 0x0>;
 };

 sprd,ion-heap@2 {
  sprd,ion-heap-mem = <0x0 0x0>;
 };

 sprd,ion-heap@3 {
  sprd,ion-heap-mem = <0x9f600000 0x400000>;
 };
};

&adi {

 headset_sprd_sc2723 {
  compatible = "sprd,headset_sprd_sc2723";
  gpio_switch = <0>;
  gpio_detect = <237>;
  gpio_button = <239>;
  irq_trigger_level_detect = <0>;
  irq_trigger_level_button = <0>;
  adc_threshold_3pole_detect = <3300>;
  adc_threshold_4pole_detect = <9999>;
  irq_threshold_buttont = <1>;
  voltage_headmicbias = <3000000>;
  nbuttons = <4>;
  headset_buttons_media {
   adc_min = <0>;
   adc_max = <535>;
   code = <226>;
   type = <0>;
  };

  headset_buttons_voc_assist {
   adc_min = <536>;
   adc_max = <726>;
   code = <0x246>;
   type = <0>;
  };

  headset_buttons_up {
   adc_min = <727>;
   adc_max = <1170>;
   code = <115>;
   type = <0>;
  };

  headset_buttons_down {
   adc_min = <1171>;
   adc_max =<2700>;
   code = <114>;
   type = <0>;
  };
 };
};


&sipc {
 reg = <0x87800000 0x240000>;
 ranges = <0x8000000 0x88000000 0x1c00000>,
     <0x07800000 0x87800000 0x180000>,
     <0x9bff000 0x89bff000 0x1000>;
 sipc_cpw {
  reg = <0x8000000 0x1c00000> ,
   <0x07800000 0x180000>,
   <0x9bff000 0x1000>;
 };
};

&scproc_cpw {
    sprd,iram-data = <0xe59f0000 0xe12fff10 0x88300000>;
        sprd,ctrl-reg = <0x44 0x44 0xb0 0xff>;
        sprd,ctrl-mask = <0x02000000 0x10000000 0x01 0xf0000>;
    reg = <0x88000000 0x1c00000>,
        <0x50000000 0x0c>,
        <0x402b0000 0x10000>,
        <0x402b0000 0x10000>,
        <0x402b0000 0x10000>,
        <0x402b0000 0x10000>;
        interrupts = <0 84 0x0>;
        #address-cells = <1>;
        #size-cells = <1>;
    ranges = <0x300000 0x88300000 0x00800000>,
           <0x20000 0x88020000 0x00220000>;
    modem {
        reg = <0x300000 0x00800000>;
    };
    dsp {
        reg = <0x20000 0x00220000>;
    };
};
